## meta-kronus-bsp/conf/layer.conf
```bitbake
# We have a conf and classes directory, add to BBPATH
BBPATH .= ":${LAYERDIR}"

# We have recipes-* directories, add to BBFILES
BBFILES += "${LAYERDIR}/recipes-*/*/*.bb \
            ${LAYERDIR}/recipes-*/*/*.bbappend"

BBFILE_COLLECTIONS += "meta-kronus-bsp"
BBFILE_PATTERN_meta-kronus-bsp = "^${LAYERDIR}/"
BBFILE_PRIORITY_meta-kronus-bsp = "6"

LAYERDEPENDS_meta-kronus-bsp = "core"
LAYERSERIES_COMPAT_meta-kronus-bsp = "scarthgap"
```

## meta-kronus-bsp/conf/machine/mpfs-disco-kit.conf
```bitbake
#@TYPE: Machine
#@NAME: mpfs-disco-kit
#@SOC: Polarfire SoC
#@DESCRIPTION: Machine configuration for the Microchip Polarfire SoC Discovery Kit

require conf/machine/include/riscv/tune-riscv.inc

MACHINE_FEATURES = "keyboard ext2 ext3 serial pci usbgadget"

KERNEL_CLASSES = "kernel-fitimage"
KERNEL_IMAGETYPE = "fitImage"
EXTERNAL_KERNEL_DEVICETREE = "${DEPLOY_DIR_IMAGE}/overlays"

PREFERRED_PROVIDER_virtual/kernel ?= "linux-mpfs"

PREFERRED_PROVIDER_u-boot ?= "u-boot-mpfs"
PREFERRED_PROVIDER_virtual/bootloader ?= "u-boot-mpfs"

UBOOT_ENTRYPOINT = "0x80200000"
UBOOT_DTB_LOADADDRESS = "0x8a000000"
UBOOT_DTBO_LOADADDRESS = "0x8a080000"
UBOOT_RD_LOADADDRESS = "0x8aa00000"
UBOOT_RD_ENTRYPOINT = "0x8aa00000"

MACHINE_EXTRA_RRECOMMENDS += " kernel-modules kernel-module-kronus-uio"

IMAGE_FSTYPES ?= "wic.xz wic.bmap"

RISCV_SBI_FDT ?= "mpfs-disco-kit.dtb"
KERNEL_DTC_FLAGS += "-@"
KERNEL_DEVICETREE ?= "microchip/${RISCV_SBI_FDT}"

UBOOT_CONFIG = "mpfs-disco-kit"
UBOOT_CONFIG[mpfs-disco-kit] = "microchip_mpfs_discokit_defconfig"

UBOOT_ENV = "boot"
UBOOT_ENV_SUFFIX = "scr"
UBOOT_ENV_SIZE = "0x2000"

HSS_PAYLOAD = "uboot"

IMAGE_BOOT_FILES ?= " \
    fitImage \
    boot.scr \
    uboot.env \
"

WIC_CREATE_EXTRA_ARGS ?= "--no-fstab-update"

WKS_FILE_DEPENDS ?= " \
    e2fsprogs-native \
    bmaptool-native \
    u-boot-mpfs \
"

WKS_FILE ?= "mpfs-rootfs.wks"
```

## meta-kronus-mpfs-bsp/conf/layer.conf
```bitbake
# We have a conf and classes directory, add to BBPATH
BBPATH .= ":${LAYERDIR}"

# We have recipes-* directories, add to BBFILES
BBFILES += "${LAYERDIR}/recipes-*/*/*.bb \
            ${LAYERDIR}/recipes-*/*/*.bbappend"

BBFILE_COLLECTIONS += "meta-kronus-mpfs-bsp"
BBFILE_PATTERN_meta-kronus-mpfs-bsp = "^${LAYERDIR}/"
BBFILE_PRIORITY_meta-kronus-mpfs-bsp = "6"

LAYERDEPENDS_meta-kronus-mpfs-bsp = "core"
LAYERSERIES_COMPAT_meta-kronus-mpfs-bsp = "scarthgap"
```

## meta-kronus-sifive-bsp/conf/layer.conf
```bitbake
# We have a conf and classes directory, add to BBPATH
BBPATH .= ":${LAYERDIR}"

# We have recipes-* directories, add to BBFILES
BBFILES += "${LAYERDIR}/recipes-*/*/*.bb \
            ${LAYERDIR}/recipes-*/*/*.bbappend"

BBFILE_COLLECTIONS += "meta-kronus-sifive-bsp"
BBFILE_PATTERN_meta-kronus-sifive-bsp = "^${LAYERDIR}/"
BBFILE_PRIORITY_meta-kronus-sifive-bsp = "6"

LAYERDEPENDS_meta-kronus-sifive-bsp = "core"
LAYERSERIES_COMPAT_meta-kronus-sifive-bsp = "scarthgap"
```

## meta-kronus/conf/distro/kronus.conf
```bitbake
DISTRO = "kronus"
DISTRO_NAME = "Kronus Embedded Linux"
DISTRO_VERSION = "2024-06.0"
DISTRO_CODENAME = "scarthgap"
SDK_VENDOR = "-kronus"
SDK_VERSION = "${@d.getVar('DISTRO_VERSION').replace('snapshot-${METADATA_REVISION}', 'snapshot')}"
SDK_VERSION[vardepvalue] = "${SDK_VERSION}"

MAINTAINER = "Brett Witherspoon <brett@witherspoon.engineering>"

IMAGE_LINGUAS = "en-us"

TARGET_VENDOR = "-kronus"

PACKAGE_CLASSES = "package_rpm"

DISTRO_FEATURES = "largefile multiarch pam"

SDK_NAME = "${DISTRO}-${TCLIBC}-${SDKMACHINE}-${IMAGE_BASENAME}-${TUNE_PKGARCH}-${MACHINE}"
SDKPATHINSTALL = "/opt/${DISTRO}/${SDK_VERSION}"

TCLIBCAPPEND = ""

require conf/distro/include/no-static-libs.inc
require conf/distro/include/yocto-uninative.inc
require conf/distro/include/security_flags.inc
INHERIT += "uninative"

BB_SIGNATURE_HANDLER ?= "OEEquivHash"
BB_HASHSERVE ??= "auto"

PREFERRED_PROVIDER_virtual/base-utils = "packagegroup-kronus-base-utils"
VIRTUAL-RUNTIME_base-utils = "packagegroup-kronus-base-utils"
VIRTUAL-RUNTIME_base-utils-hwclock = "util-linux-hwclock"
VIRTUAL-RUNTIME_base-utils-syslog = ""
VIRTUAL-RUNTIME_syslog = ""
VIRTUAL-RUNTIME_initscripts = ""
SKIP_RECIPE[busybox] = "Don't build this"

INIT_MANAGER = "systemd"

QEMU_TARGETS = "riscv64"

INHERIT += "extrausers"
EXTRA_USERS_PARAMS = "usermod -p '!' root; useradd -u 1000 -g 100 -G wheel -p '\$6\$wlgKyWldYXBmodX.\$GVrBF27RJOtIet5605KSAwtSZtt2p2PgbN.c.yWiAldJyD1fV4gZk2aQ.zCBFBUPGO5/y.ozZhKwyzsiLNVIB0' user;"
```

## meta-kronus/conf/layer.conf
```bitbake
# We have a conf and classes directory, add to BBPATH
BBPATH .= ":${LAYERDIR}"

# We have recipes-* directories, add to BBFILES
BBFILES += "${LAYERDIR}/recipes-*/*/*.bb \
            ${LAYERDIR}/recipes-*/*/*.bbappend"

BBFILE_COLLECTIONS += "meta-kronus"
BBFILE_PATTERN_meta-kronus = "^${LAYERDIR}/"
BBFILE_PRIORITY_meta-kronus = "6"

LAYERDEPENDS_meta-kronus = "core"
LAYERSERIES_COMPAT_meta-kronus = "scarthgap"
```
